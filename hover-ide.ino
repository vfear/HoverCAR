//Программа управления платой гироскутера через Ардуино
//Детский электромобиль
//Внимание все действия вы выполняете на свой страх и риск
//Прошивка еще не отлажена до идеала
//Всегда включайте первым пульт и только затем плату гироскутера
//Радио аппаратура FlySky CT6B
int CH1; //каналы радио приемника
int CH2;
int speed; //переменные на отправку 
int steer;
int n1; //дополнительно
int n2;
void setup()
{
Serial.begin(19200);
pinMode(7, OUTPUT); // Рулевое лево
pinMode(8, OUTPUT); // Рулевое право

pinMode( 2 ,INPUT_PULLUP); //Приемник на цифровой вход 2 - первый канал газ-тормоз
pinMode( 3 ,INPUT_PULLUP); //Приемник на цифровой вход 3 - второй канал руль
}
void loop()
{

//Управление платой гироскутера
//Если потеряли связь отправляем ноль
 CH1  = pulseIn(2, HIGH);

if(( ((CH1) > (1507)) || ((1495) > (CH1)) )) //Убираем помехи в нейтральном положении
{n1=CH1;}
else
{n1=1500;}
speed = (map((n1), (1100), (1900), (-1000), (1000)));
if ((CH1) == (0)) { //Потеряли связь отправляем ноль
speed = 0;
}
steer = 0; //Поворот самих колес гироскутера не требуется отправляем ноль
Serial.write((uint8_t *) &steer, sizeof(steer)); //Отправляем в порт
Serial.write((uint8_t *) &speed, sizeof(speed)); //Отправляем в порт

//Рулевое управление просто лево право через реле
//Если потеряна связь отправляем нейтраль
 CH2  = pulseIn(3, HIGH);

if(!((CH2) == (0)))
{n2=CH2;}
else
{n2=1500;}
digitalWrite(8, (n2) > (1550)); //Диапозоны срабатывания реле
digitalWrite(7, (n2) < (1450));

delay(20);


}
